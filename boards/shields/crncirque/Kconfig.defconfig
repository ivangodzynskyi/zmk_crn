## boards/shields/crncirque/Kconfig.defconfig
```kconfig
if SHIELD_CRNCIRQUE_LEFT

# Name must be less than 16 characters long!
config ZMK_KEYBOARD_NAME
    default "crnCirque"

config ZMK_SPLIT_ROLE_CENTRAL
    default y

endif

config ZMK_POINTING
    default y



config I2C
    default y



if SHIELD_CRNCIRQUE_LEFT || SHIELD_CRNCIRQUE_RIGHT

config ZMK_SPLIT
    default y

endif
```

## boards/shields/crncirque/Kconfig.shield
```kconfig
# No whitespace after the comma or in your part name!
config SHIELD_CRNCIRQUE_LEFT
    def_bool $(shields_list_contains,crncirque_left)

# No whitespace after the comma or in your part name!
config SHIELD_CRNCIRQUE_RIGHT
    def_bool $(shields_list_contains,crncirque_right)
```
